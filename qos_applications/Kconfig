## qos_applications/Kconfig
```kconfig
# January 22, 2025, 13:35:59
# larson.li
# Project configuration initialization

menu "UniRTOS Applications"

config QAPP_UNIRTOS_STD_FUNC
    bool "Standard AT command implementation"
    depends on !(QOSA_BK7258_PLATFORM_FUNC || QOSA_BK7238_PLATFORM_FUNC || QOSA_ECR6600_PLATFORM_FUNC)
    select QOSA_AT_PARSER_FUNC

orsource "unirtos_std/Kconfig"

config UNIRTOS_APP_WERROR
    bool "Treat user applications warnings as errors (-Werror)"
    default n
    help
        When enabled, compiler warnings in user application code
        will be treated as errors, causing the build to fail.
        When disabled (default), warnings only serve as reminders
        and do not prevent compilation.
        
        SDK internal code always treats warnings as errors
        regardless of this setting.

endmenu
```
