## qos_components/system/modem/config/Kconfig.modem.at
```kconfig
# Copyright (C) 2023 UniRTOS.
# All rights reserved.
#

menu "Network AT config"
depends on !(QOSA_BK7258_PLATFORM_FUNC || QOSA_BK7238_PLATFORM_FUNC || QOSA_ECR6600_PLATFORM_FUNC)

config QOSA_MODEM_AT_NW_RSSI_QCSQ_LTE_SPEC
    bool "Whether QCSQ command displays RSSI value in special format under LTE system"
    default n
    help
        If n, the absolute value of the measurement will be used

config QOSA_MODEM_AT_NW_RSSI_QCSQ_LTE_SPEC_VAL
    int "Special RSSI value format for QCSQ command under LTE system 0: Use measurement value 1: Use reported value 2: Use absolute value of measurement (default)"
    default 2
    range 0 2
    help
        This configuration will affect the RSSI parameter format in QCSQ command and URC under LTE system

config QOSA_MODEM_AT_NW_RSSI_QCSQ_GSM_SPEC
    bool "Whether QCSQ command displays RSSI value in special format under GSM system"
    default n
    help
        If n, the absolute value of the measurement will be used

config QOSA_MODEM_AT_NW_RSSI_QCSQ_GSM_SPEC_VAL
    int "Special RSSI value format for QCSQ command under GSM system 0: Use measurement value 1: Use reported value 0~31 2: Use reported value 0~63 3: Use absolute value of measurement (default)"
    default 3
    range 0 3
    help
        This configuration will affect the RSSI parameter format in QCSQ command under GSM system

config QOSA_MODEM_AT_NW_RXLEV_QENG_GSM_SPEC
    bool "Whether QENG command displays RXLEV value in special format under GSM system"
    default n
    help
        If n, the measurement value will be used

config QOSA_MODEM_AT_NW_RXLEV_QENG_GSM_SPEC_VAL
    int "Special RXLEV value format for QENG command under GSM system 0: Use measurement value (default) 1: Use reported value 0~31 2: Use reported value 0~63 3: Use absolute value of measurement"
    default 0
    range 0 3
    help
        This configuration will affect the RXLEV parameter format in QENG command under GSM system

config QOSA_MODEM_AT_NW_RXLEV_QCELL_GSM_SPEC
    bool "Whether QCELL command displays RXLEV value in special format under GSM system"
    default n
    help
        If n, the measurement value will be used

config QOSA_MODEM_AT_NW_RXLEV_QCELL_GSM_SPEC_VAL
    int "Special RXLEV value format for QCELL command under GSM system 0: Use measurement value (default) 1: Use reported value 0~31 2: Use reported value 0~63 3: Use absolute value of measurement"
    default 0
    range 0 3
    help
        This configuration will affect the RXLEV parameter format in QCELL command under GSM system

config QOSA_MODEM_AT_NW_RXLEV_QOPS_GSM_SPEC
    bool "Whether QOPS command displays RXLEV value in special format under GSM system"
    default n
    help
        If n, the reported value will be used

config QOSA_MODEM_AT_NW_RXLEV_QOPS_GSM_SPEC_VAL
    int "Special RXLEV value format for QOPS command under GSM system 0: Use measurement value 1: Use reported value 0~31 2: Use reported value 0~63 (default) 3: Use absolute value of measurement"
    default 2
    range 0 3
    help
        1. This configuration will affect the RXLEV parameter format in QOPS command under GSM system

config QOSA_MODEM_AT_NW_SINR_QCSQ_SPEC
    bool "Whether QCSQ command displays SINR value in special format"
    default n
    help
        1. If n, SINR value in (x+20)*5 format will be used

config QOSA_MODEM_AT_NW_SINR_QCSQ_SPEC_VAL
    int "Special SINR parameter format in QCSQ command 0: Use measurement value 1: Use reported value 2: Use special algorithm value (default)"
    default 2
    range 0 2
    help
        1. This configuration will affect the SINR parameter format in QCSQ command and URC

config QOSA_MODEM_AT_NW_SINR_QENG_SPEC
    bool "Whether QENG command displays SINR value in special format"
    default n
    help
        1. If n, SINR value of measurement will be used

config QOSA_MODEM_AT_NW_SINR_QENG_SPEC_VAL
    int "Special SINR parameter format in QENG command 0: Use measurement value (default) 1: Use reported value 2: Use special algorithm value"
    default 0
    range 0 2
    help
        1. This configuration will affect the SINR parameter format in QENG command

config QOSA_MODEM_AT_NW_SINR_QCELL_SPEC
    bool "Whether QCELL command displays SINR value in special format"
    default n
    help
        1. If n, SINR value of measurement will be used

config QOSA_MODEM_AT_NW_SINR_QCELL_SPEC_VAL
    int "Special SINR parameter format in QCELL command 0: Use measurement value (default) 1: Use reported value 2: Use special algorithm value"
    default 0
    range 0 2
    help
        1. This configuration will affect the SINR parameter format in QCELL command

endmenu

menu "SIM AT config"
endmenu
```

## qos_components/system/modem/config/Kconfig.modem.datacall
```kconfig
# Copyright (C) 2023 UniRTOS.
# All rights reserved.
#

menu "datacall"
depends on !(QOSA_BK7258_PLATFORM_FUNC || QOSA_BK7238_PLATFORM_FUNC || QOSA_ECR6600_PLATFORM_FUNC)

config QOSA_DATACALL_LIGHT_MODE
    bool "datacall light mode"
    default y
    help
        enable datacall light mode, which means the OSA datacall application in the OSA layer will not maintain the DATACALL state

config QOSA_DATACALL_MPC_DEFINED_MASK
    bool "MPC defined mask"
    default n
    help
        enable MPC defined mask in datacall light mode, which means that "datacall pdp defined" flag will be set in MPC layer

config QOSA_DATACALL_PROFILES_STORE_IN_MPC
    bool "profiles store in MPC"
    default y if QOSA_DATACALL_LIGHT_MODE
    default n
    help
        enable profiles store in MPC layer, which means that the profiles will be stored in MPC layer instead of OSA layer

config QOSA_DATACALL_LIGHT_MODE_SUPPORT_USBNET
    bool "support USBNET"
    default n
    help
        enable support for USBNET in datacall light mode

config QOSA_DATACALL_LIGHT_MODE_SUPPORT_PPP
    bool "support PPP"
    default n
    help
        enable support for PPP in datacall light mode

config QOSA_DATACALL_PDPID_MAX
    int "maximum PDPID"
    default 7
    range 1 65535
    help
        maximum PDPID supported by modem

config QOSA_MODEM_TASK_STACK_SIZE
    int "unirtos modem task size"
    default 16
    range 0 16
    help
        unirtos modem task size

endmenu
```

## qos_components/system/modem/config/Kconfig.modem.network
```kconfig
# Copyright (C) 2023 UniRTOS.
# All rights reserved.
#

menu "network"
depends on !(QOSA_BK7258_PLATFORM_FUNC || QOSA_BK7238_PLATFORM_FUNC || QOSA_ECR6600_PLATFORM_FUNC)

config QOSA_NW_GSM_SUPPORT
    bool "whether support GSM or not"
    default y

config QOSA_NW_WCDMA_SUPPORT
    bool "whether support WCDMA or not"
    default y

config QOSA_NW_LTE_SUPPORT
    bool "whether support LTE or not"
    default y

config QOSA_NW_NR_SUPPORT
    bool "whether support NR or not"
    default y

config QOSA_NW_LTE_ONLY
    bool "is LTE only module?"
    default n

config QOSA_NW_REJECT_CAUSE_SUPPORT
    bool "whether support reject cause or not"
    default y

config UNIRTOS_JAMM_DETECT_SHAKEPERIOD_DEFAULT
    int "default jamming detect"
    default 3
    range 1 10
    help
        default jamming detect supported by network

config UNIRTOS_JAMM_DETECT_RSSI_DEFAULT
    int "default jamming detect"
    default -50
    range -120 -20
    help
        default jamming detect supported by network

config UNIRTOS_JAMM_DETECT_RSSI_MAX
    int "maximum jamming detect"
    default -50
    range -120 -20
    help
        maximum jamming detect supported by network

config UNIRTOS_JAMM_DETECT_RSSI_MIN
    int "minimum jamming detect"
    default -50
    range -120 -20
    help
        minimum jamming detect supported by network

config UNIRTOS_JAMM_DETECT_RSRQ_DEFAULT
    int "default jamming detect"
    default -15
    range -20 0
    help
        default jamming detect supported by network

config UNIRTOS_JAMM_DETECT_RSRQ_MAX
    int "maximum jamming detect"
    default -15
    range -20 0
    help
        maximum jamming detect supported by network

config UNIRTOS_JAMM_DETECT_RSRQ_MIN
    int "minimum jamming detect"
    default -15
    range -20 0
    help
        minimum jamming detect supported by network

config UNIRTOS_JAMM_DETECT_RSRP_DEFAULT
    int "default jamming detect"
    default -105
    range -140 -44
    help
        default jamming detect supported by network

config UNIRTOS_JAMM_DETECT_SINR_DEFAULT
    int "default jamming detect"
    default -7
    range -50 63
    help
        default jamming detect supported by network

config UNIRTOS_JAMM_DETECT_SINR_MAX
    int "maximum jamming detect"
    default -7
    range -50 63
    help
        maximum jamming detect supported by network

config UNIRTOS_JAMM_DETECT_SINR_MIN
    int "minimum jamming detect"
    default -7
    range -50 63
    help
        minimum jamming detect supported by network

config QOSA_OPER_EUROPE_AREA
    bool "Europe Operator"
    default n
    help
      Enable Europe region operator configuration for QOSA.

config QOSA_OPER_LATIN_AMERICA_AREA
    bool "Latin America Operator"
    default n
    help
      Enable Latin America region operator configuration for QOSA.

config QOSA_OPER_NORTH_AMERICA_AREA
    bool "North America Operator"
    default n
    help
      Enable North America region operator configuration for QOSA.

config QOSA_OPER_OCEANIA_AREA
    bool "Oceania Operator"
    default n
    help
      Enable Oceania region operator configuration for QOSA.

config QOSA_OPER_ASIA_AREA
    bool "Asia Operator"
    default n
    help
      Enable Asia region operator configuration for QOSA (including India).

config QOSA_OPER_GL_AREA
    bool "Legacy global operator option (use Global Operator)"
    select QOSA_OPER_GLOBAL_AREA
    default n
    help
      Compatibility input for existing modem.config files using GL_AREA.
      New project configurations should use QOSA_OPER_GLOBAL_AREA.

config QOSA_OPER_GLOBAL_AREA
    bool "Global Operator"
    default n
    help
      Enable global operator configuration for QOSA.
      This allows the modem to use global network/PLMN settings.

endmenu
```

## qos_components/system/modem/config/Kconfig.modem.sim
```kconfig
# Copyright (C) 2023 UniRTOS.
# All rights reserved.
#

menu "sim"
depends on !(QOSA_BK7258_PLATFORM_FUNC || QOSA_BK7238_PLATFORM_FUNC || QOSA_ECR6600_PLATFORM_FUNC)

config QOSA_SIM_FACILITY_AB
    bool "AB"
    default n

config QOSA_SIM_FACILITY_AC
    bool "AC"
    default n

config QOSA_SIM_FACILITY_AG
    bool "AG"
    default n

config QOSA_SIM_FACILITY_AI
    bool "AI"
    default n

config QOSA_SIM_FACILITY_AO
    bool "AO"
    default n

config QOSA_SIM_FACILITY_IR
    bool "IR"
    default n

config QOSA_SIM_FACILITY_OI
    bool "OI"
    default n

config QOSA_SIM_FACILITY_OX
    bool "OX"
    default n

config QOSA_SIM_FACILITY_SC
    bool "SC"
    default y

config QOSA_SIM_FACILITY_P2
    bool "P2"
    default n

config QOSA_SIM_CRSM_P3_ZERO_REPLACED_BY_FF
    bool "replace 0 by 0xff for CRSM p3"
    default n


config QOSA_SIM_LOGICAL_CHANNEL_NUM
    int "logical channel numbers for spceical platform"
    default 8

config QOSA_SIM_DIFF_USE_MPC_SIM_INIT
    bool "whether get sim/sms/pbk init status data from MPC"
    default n

endmenu
```

## qos_components/system/modem/config/Kconfig.modem.usbnet
```kconfig
# Copyright (C) 2023 UniRTOS.
# All rights reserved.
#

menu "usbnet"
depends on !(QOSA_BK7258_PLATFORM_FUNC || QOSA_BK7238_PLATFORM_FUNC || QOSA_ECR6600_PLATFORM_FUNC)

config QOSA_USBNET_MBIM
    bool "MBIM"
    default n

config QOSA_USBNET_NCM
    bool "NCM"
    default n

config QOSA_USBNET_LIGHT_MODE
    bool "Light Mode"
    default n

endmenu
```
