## qos_components/components/Kconfig
```kconfig
# Copyright (C) 2023 UniRTOS.
# All rights reserved.
#

menu "UniRTOS components"

config QCM_FILE_API_FUNC
    bool "Enable file API interface function"
    select QOSA_VFS_FILESYSTEM_FUNC
    select QCM_UTILS_UTF8_FUNC
    default y

config QCM_SOCKET_ADP_FUNC
    bool "Enable socket adapter function"
    default y

config QCM_VTLS_FUNC
    bool "Enable VTLS SSL function"
    select QOSA_SSL_FUNC
    select QCM_UTILS_UTILS_FUNC
    default n

config QCM_QURL_FUNC
    bool "Enable QURL function"
    select QCM_SOCKET_ADP_FUNC
    default n

config QCM_QURL_HTTP_FUNC
    bool "Enable QURL HTTP function"
    select QCM_QURL_FUNC
    default n

config QCM_QURL_FTP_FUNC
    bool "Enable QURL FTP function"
    select QCM_QURL_FUNC
    default n

config QCM_QURL_SMTP_FUNC
    bool "Enable QURL SMTP function"
    select QCM_QURL_FUNC
    default n

config QCM_UTILS_BASE64_FUNC
    bool "Enable base64 encode/decode support"
    default n

config QCM_UTILS_TLV_FUNC
    bool "Enable TLV support"
    default n

config QCM_UTILS_UTF8_FUNC
    bool "Enable UTF-8 validation support"
    default n

config QCM_UTILS_UTILS_FUNC
    bool "Enable common string utility support"
    default n

config QCM_UTILS_XMODEM_FUNC
    bool "Enable XMODEM file function"
    default n

config QCM_MINI_HTTP_FUNC
    bool "Enable mini HTTP function"
    select QCM_SOCKET_ADP_FUNC
    default n

config QCM_LBS_FUNC
    bool "Enable LBS function"
    select QCM_SOCKET_ADP_FUNC
    select QCM_UTILS_TLV_FUNC
    select QCM_UTILS_UTILS_FUNC
    depends on (QCM_QURL_FUNC || QCM_MINI_HTTP_FUNC)
    default n

config QCM_MMS_FUNC
    bool "Enable MMS function"
    select QCM_SOCKET_ADP_FUNC
    select QCM_FILE_API_FUNC
    default n

config QCM_MQTT_FUNC
    bool "Enable MQTT function"
    select QCM_SOCKET_ADP_FUNC
    select QCM_UTILS_UTF8_FUNC
    default n

config QCM_MQTT5_FUNC
    bool "Enable MQTT 5.0 function"
    select QCM_MQTT_FUNC
    default n

config QCM_FILE_SFS_FUNC
    bool "Enable file SFS (SFS:) function"
    select QCM_FILE_API_FUNC
    select QOSA_SSL_FUNC
    default n

config QCM_NTP_FUNC
    bool "Enable NTP function"
    select QCM_SOCKET_ADP_FUNC
    default n

config QCM_SBFOTA_FUNC
    bool "Enable SBFOTA function"
    select QCM_SOCKET_ADP_FUNC
    select QCM_UTILS_UTF8_FUNC
    select QCM_UTILS_UTILS_FUNC
    select QCM_QURL_FUNC
    default n

config QCM_WEBSOCKET_FUNC
    bool "Enable WebSocket function"
    select QCM_SOCKET_ADP_FUNC
    select QCM_UTILS_BASE64_FUNC
    default n

config QCM_PING_FUNC
    bool "Enable ping function"
    select QCM_SOCKET_ADP_FUNC
    default n

config QCM_COAP_FUNC
    bool "Enable CoAP function"
    select QCM_SOCKET_ADP_FUNC
    default n

config QCM_COAP_API_FUNC
    bool "Enable CoAP API function"
    select QCM_COAP_FUNC
    default n

config QCM_LWM2M_FUNC
    bool "Enable LwM2M function"
    select QCM_COAP_FUNC
    select QCM_SOCKET_ADP_FUNC
    select QCM_FILE_API_FUNC
    default n

config QCM_LWM2M_DTLS_FUNC
    bool "Enable LwM2M DTLS function"
    select QCM_LWM2M_FUNC
    select QCM_VTLS_FUNC
    default n

config QCM_LWM2M_FOTA_FUNC
    bool "Enable LwM2M FOTA function"
    select QCM_LWM2M_FUNC
    select QCM_QURL_FUNC
    default n

config QCM_URC_FUNC
    bool "Enable URC function"
    default n

config QCM_UART_LOG_FUNC
    bool "Enable UART log function"
    default n
	
config QCM_SPI_NOR_FUNC
    bool "Enable SPI NOR function"
    select QOSA_SPI_FUNC
    default n

config QCM_DMHTTP_FUNC
    bool "Enable CMCC device management function"
    select QCM_QURL_FUNC
    select QCM_FILE_API_FUNC
    select QCM_UTILS_BASE64_FUNC
    select QCM_UTILS_UTILS_FUNC
    default n

config QCM_VIRT_AT_FUNC
    bool "Enable virtual AT function"
    select QOSA_VIRT_AT_FUNC
    default n

config QCM_QVSIM_FUNC
    bool "Enable QVSIM function"
    select QCM_FILE_API_FUNC
    select QCM_SOCKET_ADP_FUNC
    select QCM_QURL_FUNC
    default n

config QCM_AUDIO_STREAM_FUNC
    bool "Enable audio stream function"
    select QOSA_AUDIO_DRIVER
    select QCM_AUDIO_MP3_FUNC
    select QCM_AUDIO_AMR_FUNC
    default n

config QCM_AUDIO_MP3_FUNC
    bool "Enable audio MP3 function"
    default n

config QCM_AUDIO_AMR_FUNC
    bool "Enable audio AMR function"
    default n

config QCM_ESIM_FUNC
    bool "Enable eSIM function"
    select QCM_UTILS_UTILS_FUNC
    select QCM_QURL_FUNC
    default n

config QCM_MBEDTLS_LIBRARY_FUNC
    bool "Enable mbedTLS function"
    default n

choice
    prompt "mbedtls version"
    depends on QCM_MBEDTLS_LIBRARY_FUNC
    default QCM_MBEDTLS_2_LIBRARY_FUNC

config QCM_MBEDTLS_2_LIBRARY_FUNC
    bool "Enable mbedTLS 2.x"

config QCM_MBEDTLS_4_LIBRARY_FUNC
    bool "Enable mbedTLS 4.x"
endchoice

config QCM_MBEDTLS_CONFIG_FILE
    bool "Enable mbedTLS config file function"
    depends on QCM_MBEDTLS_LIBRARY_FUNC
    default n

config QCM_GNSS_FUNC
    bool "Enable GNSS function"
    select QCM_QURL_FUNC
    select QCM_NTP_FUNC
    default n


orsource "comp_config.Kconfig"
endmenu
```
