## qos_kernel/bk7258/arch_prj/ql_application/Kconfig.projbuild
```kconfig
menu "QuecOS Project Configuration"
    config QUEC_OS_SUPPORT
        bool "Enable QuecOS Support"
        default y
endmenu
```

## qos_kernel/bk7258/arch_prj/ql_components/components/bk_audio_player/Kconfig
```kconfig
menu "Bk_audio_player"
	config AUDIO_PLAYER
		bool "Enable bk_audio_player"
		default n

	choice AUDIO_PLAYER_USE_MEMORY
		depends on AUDIO_PLAYER
		prompt "Select audio player use memory"
		default AUDIO_PLAYER_USE_SRAM

		config AUDIO_PLAYER_USE_SRAM
			bool "Enable audio player use sram"
			help
				audio player use sram memory

		config AUDIO_PLAYER_USE_PSRAM
			depends on PSRAM
			bool "Enable audio player use psram"
			help
				audio player use psram memory
	endchoice

	config AUDIO_PLAYER_NET_PIPE_SIZE
		depends on AUDIO_PLAYER
		int "HTTP net source pipe size"
		default 8192
		help
			HTTP net source ring buffer size in bytes.

	config AUDIO_PLAYER_HLS_NET_PIPE_SIZE
		depends on AUDIO_PLAYER
		int "HLS net source pipe size"
		default 8192
		help
			HLS net source ring buffer size in bytes.

	config AUDIO_PLAYER_WEB_RETRY_COUNT
		depends on AUDIO_PLAYER
		int "HTTP net source retry count"
		default 10
		help
			Retry count used when the HTTP net source socket closes before
			the expected content length is received.

endmenu
```

## qos_kernel/bk7258/arch_prj/ql_components/components/bk_draw_osd/Kconfig
```kconfig
menu "Media::Draw_osd"

	config MEDIA_OSD
		bool "Enable software draw osd component"
		default n
		help
			This option enables the software draw osd component.

endmenu
```

## qos_kernel/bk7258/arch_prj/ql_components/components/bk_jpeg_decoder/Kconfig
```kconfig
menu "JPEG Decoder"

	config JPEG_DECODER
		bool "Enable JPEG Decoder"
		default y
		help
			Enable jpeg decoder service
	
	config JPEG_DECODER_SW
		depends on JPEG_DECODER
		bool "Enable JPEG Decoder Software"
		default y
		help
			Enable jpeg decoder software service

	config SW_JPEG_DECODE_TASK_STACK_SIZE
		int "Software JPEG decode task stack size"
		default 1024
		depends on JPEG_DECODER_SW
		help
			Stack size in bytes for software JPEG decode task (default: 1024)

	config JPEG_DECODER_HW
		depends on JPEG_DECODER
		bool "Enable JPEG Decoder Hardware"
		default y
		help
			Enable jpeg decoder hardware service

	config HW_JPEG_DECODE_TASK_STACK_SIZE
		int "Hardware JPEG decode task stack size"
		default 1024
		depends on JPEG_DECODER_HW
		help
			Stack size in bytes for hardware JPEG decode task (default: 1024)

	config HW_JPEG_DECODE_TASK_PRIORITY
		int "Hardware JPEG decode task pirority"
		default 6
		depends on JPEG_DECODER_HW
		help task pirority
			

endmenu
```

## qos_kernel/bk7258/arch_prj/ql_components/components/bk_network_provisioning/Kconfig
```kconfig
menu "Beken Components Network Provisioning"
	config BK_NETWORK_PROVISIONING
		bool "Enable Beken Network Provisioning"
		default n

	config BK_BLE_PROVISIONING
		bool "Enable BLE Service for Network Provisioning"
		depends on BK_NETWORK_PROVISIONING
		default n

	config BK_NETWORK_PROVISIONING_BLE_EXAMPLE
		bool "Enable Network Provisioning BLE Example"
		depends on BK_BLE_PROVISIONING
		default n
endmenu
```

## qos_kernel/bk7258/arch_prj/ql_components/components/bk_video_pipeline/Kconfig
```kconfig
menu "Video Pipeline"

	config VIDEO_PIPELINE
		bool "Enable Video Pipeline"
		default y
		help
			Enable video pipeline service
	



endmenu
```

## qos_kernel/bk7258/arch_prj/ql_components/components/multimedia/Kconfig
```kconfig
menu "Media"

	config MEDIA
		bool "Enable Media"
		default n
		help
			Enable media service

	config LCD_FLASH_JPEG_DISPLAY
		depends on LCD
		bool "Enable Lcd Flash Jpeg Display"
		default n
		help
			enable lcd display flash img

	config LCD_DMA2D_BLEND
		depends on DMA2D
		bool "Enable Lcd Dma2d Blend Flash Img"
		default n
		help
			enable lcd dma2d blend flash logo

	config BLEND_USE_GUI
		depends on LCD
		bool "Enable Blend Use Gui"
		default n
		help
			enable lcd dma2d blend from gui

	config BLEND_GUI_OUTPUT_888
		depends on LCD
		bool "Enable Blend Gui Output 888"
		default n
		help
			enable lcd dma2d blend from gui, gui data is rgb888

	config LCD_FONT_BLEND
		depends on LCD
		bool "Enable Lcd Font Blend"
		default n
		help
			enable lcd blend by font logo

	config EXTENTED_PSRAM_LAYOUT
		bool "Externally controlling the PSRAM range of the framebuffer"
		default n
		help
			extern external fb_layout variable

	config LCD_ROTATE
		depends on LCD
		bool "Enable Lcd rotate function"
		default n

	config LCD_HW_PFC
		depends on LCD
		bool "Enable Lcd hw pixel convert"
		default n

	config LCD_HW_DECODE
		depends on LCD
		bool "Enable Lcd hw decode"
		default n

	config SW_ROTATE_TO_YUYV_AND_DMA2D_TO_YUYV_NOT_RGB888
		depends on LCD
		bool "Enable SW rotate to YUYV and DMA2D to YUYV not RGB888"
		default n

	config LCD_SW_DECODE
		depends on LCD
		bool "Enable Lcd sw decode"
		default n

	config LCD_AUTO_FILL_FULL
		depends on LCD
		bool "Enable Lcd auto fill full"
		default n

	config MEDIA_PIPELINE
		depends on LCD
		bool "Enable MEDIA PIPELINE"
		default n

	config JPEG_DECODE_PIPELINE_TASK_STACK_SIZE
		depends on MEDIA_PIPELINE
		int "JPEG decode pipeline task stack size"
		default 4096
		help
			Stack size in bytes for JPEG decode pipeline task (default: 4096)

	config JPEG_GET_PIPELINE_TASK_STACK_SIZE
		depends on MEDIA_PIPELINE
		int "JPEG get pipeline task stack size"
		default 1024
		help
			Stack size in bytes for JPEG get pipeline task (default: 1024)

	config YUV_ROTATE_PIPELINE_TASK_STACK_SIZE
		depends on MEDIA_PIPELINE
		int "YUV rotate pipeline task stack size"
		default 2048
		help
			Stack size in bytes for YUV rotate pipeline task (default: 2048)

	config H264_ENCODE_PIPELINE_TASK_STACK_SIZE
		depends on MEDIA_PIPELINE
		int "H264 encode pipeline task stack size"
		default 2048
		help
			Stack size in bytes for H264 encode pipeline task (default: 2048)

	config MEDIA_BT_AUDIO
		bool "BT USE AUDIO Module"
		default n
		help
			BT Module Will Use AUDIO Module

	config SOFTWARE_DECODE_SRAM_MAPPING
		bool "Enable Software Decode Sram Mapping"
		default n

	config MEDIA_PSRAM_SIZE_4M
		bool "The PSRAM used by the media is within 4M."
			default n

	config JPEG_SW_DECODE_SUPPORT_BY_FRAME
		bool "Enable JPEG software decode by frame"
		default y

	config JPEG_SW_DECODE_SUPPORT_BY_LINE
		bool "Enable JPEG software decode by line"
		default y

	config SUPPORTED_IMAGE_MAX_720P
		bool "support 1280X720 pipeline"
		default n

	config JPEG_FRAME_SIZE
		int "config a jpeg frame size unit(byte), range 0-200k, default 100k"
		range 0 204800
		default 102400

	config H264_FRAME_SIZE
		int "config a h264 NALU size unit(byte), range 0-200k, default 100k"
		range 0 204800
		default 102400

endmenu
```

## qos_kernel/bk7258/arch_prj/ql_components/components/multimedia/bk_encoder/bk_jpeg_encode/Kconfig
```kconfig
menu "JPEG encoder service"

	config JPEG_ENCODER
		depends on JPEGENC_HW
		bool "Enable JPEG encoder"
		default n
		help
			Enable jpeg encoder service

endmenu
```

## qos_kernel/bk7258/arch_prj/ql_components/middleware/soc/bk7257_ap/bk7257_ap.defconfig
```kconfig
#The value config in bk7257.defconfig will over write the Kconfig's default value.
#If the default value in Kconfig satisfy your needs, then you needn't to config again here.

CONFIG_SOC_ARCH="cm33"
CONFIG_SOC_BK7236XX=y
CONFIG_SOC_BK7257=y
CONFIG_SOC_STR="bk7257_ap"
CONFIG_ARCH_CM33=y
CONFIG_CMSIS=y
CONFIG_DEFAULT_CMSIS_START=n

CONFIG_CPU_CNT=2
CONFIG_SOC_SMP=y
CONFIG_BUILD_DEFAULT_VERSION=y

#
# Spinlock
#
CONFIG_SPINLOCK=y
CONFIG_SPINLOCK_SECTION=y
CONFIG_SPINLOCK_DYNAMIC_CNT=512
CONFIG_SPINLOCK_STATIC_CNT=128
# end of Spinlock


CONFIG_MAILBOX=y
CONFIG_MAILBOX_V2_0=y
CONFIG_SLAVE_HEART_BEAT=y


#
# Test Configuration
#
CONFIG_INTERRUPT_TEST=y
CONFIG_AON_PMU_TEST=y



#Enable for FPGA board
CONFIG_SPE=1

#
# ARMINO Configuration
#

#
# Common Configuration
#
CONFIG_CACHE_ENABLE=n
CONFIG_MPU=y

#
# Debug
#
CONFIG_ASSERT_REBOOT=y
# CONFIG_ASSERT_HALT is not set
# CONFIG_ASSERT_REBOOT is not set
# CONFIG_JTAG is not set
# end of Debug
# end of Common Configuration

#
# Features Configuration
#
#CONFIG_LWIP_V2_0 is not set
CONFIG_LWIP_V2_1=y
CONFIG_NO_HOSTED=y
CONFIG_LWIP_MEM_LIBC_MALLOC=y
CONFIG_LWIP_MEMP_MEM_MALLOC=y
# CONFIG_SEMI_HOSTED is not set
# CONFIG_FULLY_HOSTED is not set
# CONFIG_WIFI_SENSOR is not set
CONFIG_ANA_REG_WRITE_POLL_REG_B=n
# end of Features Configuration



#
# Components Configuration
#

#
# Application
#
# CONFIG_DEMO_TEST is not set
# CONFIG_FTPD_UPGRADE is not set

CONFIG_HTTP=y
CONFIG_OTA_HTTP=y
CONFIG_HTTP_OTA_WITH_BLE=y
CONFIG_OTA_FUNCTION=y

# CONFIG_OTA_TFTP is not set
CONFIG_IPERF_TEST=y
# end of Application

CONFIG_AT=n

#
# Audio
#
CONFIG_AUDIO=y
CONFIG_AUDIO_ADC=y
CONFIG_AUDIO_DAC=y
# end of Audio

#
# Calibration
#
# end of Calibration

#
# ATE
#
CONFIG_ATE=n
CONFIG_ATE_TEST=n
# end of ATE

#
# BLE
#
CONFIG_BT=n
CONFIG_BLUETOOTH=n
# end of BLE

#
# Cli
#
CONFIG_CLI=y
CONFIG_LOG_LEVEL=6
CONFIG_SHELL_ASYNCLOG=y
CONFIG_DYM_LOG_MEM_MAX=0x10000
CONFIG_MAX_COMMANDS=256
CONFIG_BKREG=n
# CONFIG_TCP_SERVER_TEST is not set
# CONFIG_AIRKISS_TEST is not set
# CONFIG_WIFI_RAW_TX_TEST is not set
# CONFIG_I2C1_TEST is not set
# CONFIG_I2C2_TEST is not set
# CONFIG_UART_TEST is not set
# CONFIG_SPI_TEST is not set
# CONFIG_PERI_TEST is not set
# CONFIG_RF_OTA_TEST is not set
# end of Cli

#
# RF
#
# end of RF

#
# Internal Kconfig
#
CONFIG_MCU_PS=n
CONFIG_DEEP_PS=n
CONFIG_TICK_CALI=y
CONFIG_STA_PS=n
# end of Internal Kconfig

#
# FreeRTOS
#
CONFIG_FREERTOS=y
CONFIG_FREERTOS_SMP=y
CONFIG_FREERTOS_TRACE=n
CONFIG_FREERTOS_ALLOW_OS_API_IN_IRQ_DISABLED=y
CONFIG_OS_SMP_AFFINITY_DEMO=y

#
# Memory Debug
#
# CONFIG_MALLOC_STATIS is not set
CONFIG_MEM_DEBUG=y
# end of Memory Debug
# end of FreeRTOS
CONFIG_CM_BACKTRACE=y

#
# Startup
#
CONFIG_APP_MAIN_TASK_PRIO=0
CONFIG_APP_MAIN_TASK_STACK_SIZE=4096
# end of Startup

#
# System
#
CONFIG_FLASH=y
CONFIG_FLASH_MB=y
CONFIG_NEW_MAC_POLICY=y
CONFIG_BK_MAC_ADDR_CHECK=y
CONFIG_RESET_REASON=y
# end of System

#
# Mbedtls
#
CONFIG_PSA_MBEDTLS=y
CONFIG_FULL_MBEDTLS=n
CONFIG_MBEDTLS_USE_PSA_CRYPTO=n
CONFIG_TRUSTENGINE=y
CONFIG_SW_CRYPTO=n
CONFIG_TE200_ENTROPY=y
CONFIG_MBEDTLS_LOG_LEVEL="OFF"
CONFIG_AON_ENCP=y
CONFIG_PSA_MBEDTLS_TEST=n
CONFIG_TRUSTENGINE_TEST=n
# end of Mbedtls
#

# USB configuration
#
CONFIG_USB=y
CONFIG_USB_VBAT_CONTROL_GPIO_ID=0x1C
CONFIG_TASK_USB_PRIO=2
CONFIG_USB_DMA_ENABLE=y
CONFIG_USB_HOST=y
CONFIG_USBH_MSC=y
CONFIG_USBH_UVC=y
CONFIG_USBH_UAC=y
CONFIG_USBH_SERIAL_CH340=y

CONFIG_USB_HUB=y
CONFIG_USB_HUB_MULTIPLE_DEVICES=y
CONFIG_USBHOST_HUB_MAX_EHPORTS=4
CONFIG_USBHOST_HUB_PORT_SUPPORT_MAX_DEVICE=5
CONFIG_USBHOST_HUB_PORT_1_VBAT_CONTROL_GPIO_ID=0xFF

CONFIG_USB_DEVICE=n
CONFIG_USBD_MSC=n
CONFIG_USBD_HID=n
# end of USB configuration

#
# WiFi
#
CONFIG_WIFI_ENABLE=n
CONFIG_WIFI6_CODE_STACK=n
CONFIG_WIFI6=n
CONFIG_WIFI4=n
CONFIG_MSDU_RESV_TAIL_LENGTH=16
CONFIG_TASK_RECONNECT_PRIO=4
# CONFIG_AP_MONITOR_COEXIST is not set
# CONFIG_WIFI_FAST_CONNECT is not set
# CONFIG_BSSID_CONNECT is not set
# CONFIG_WFA_CERT is not set
# CONFIG_LESS_MEMERY_IN_RWNX is not set
# CONFIG_AP_PROBEREQ_CB is not set
CONFIG_WIFI6_IP_DEBUG=y
# end of WiFi

#
# BLE 5.x
#
# end of BLE 5.x

#
# Driver
#

#
# AON_RTC
#
CONFIG_AON_RTC=y
# end of AON_RTC


CONFIG_SYSTEM_CTRL=y
CONFIG_HAL_DEBUG_SYS=y
CONFIG_AON_PMU=y

# I2C
#
#
CONFIG_I2C=y
CONFIG_I2C_SUPPORT_ID_BITS=2
CONFIG_SIM_I2C=n

#
# UART
#
CONFIG_UART0=y
CONFIG_UART1=y
CONFIG_UART2=y

CONFIG_SYS_PRINT_DEV_MAILBOX=y
CONFIG_SYS_PRINT_DEV_UART=n
CONFIG_UART_PRINT_PORT=1
CONFIG_PRINTF_BUF_SIZE=256
# CONFIG_BACKGROUND_PRINT is not set
CONFIG_KFIFO_SIZE=128
CONFIG_UART_ERR_INTERRUPT=y
# CONFIG_UART_STATIS is not set
# end of UART

#
# TRNG
#
CONFIG_TRNG_SUPPORT=y
# end of TRNG

#depends on CONFIG_TRNG_SUPPORT
CONFIG_RANDOM_MAC_ADDR=y

#
# FATFS
#
CONFIG_FATFS=y
CONFIG_FATFS_SDCARD=y
CONFIG_FATFS_SPI_0_FLASH=n
CONFIG_FATFS_SPI_1_FLASH=n
CONFIG_FATFS_QSPI_0_FLASH=n
CONFIG_FATFS_QSPI_1_FLASH=n
# end of FATFS



CONFIG_LITTLEFS=y
CONFIG_LFS_THREADSAFE=y


CONFIG_MAC_PHY_BYPASS=y

#
# SDIO
#
CONFIG_SDCARD=y
CONFIG_SDCARD_DEFAULT_CLOCK_FREQ=14
CONFIG_SDCARD_POWER_GPIO_CTRL=y
CONFIG_SDCARD_DEBUG_SUPPORT=n
CONFIG_SDCARD_BUSWIDTH_4LINE=n
CONFIG_SDIO_4LINES_EN=n
CONFIG_SDIO=y
CONFIG_SDIO_V1P0=n
CONFIG_SDIO_V2P0=y
CONFIG_SDIO_GDMA_EN=n
CONFIG_SDIO_HOST=y
CONFIG_SDIO_HOST_DEFAULT_CLOCK_FREQ=7
CONFIG_SDIO_HOST_CLR_WRITE_INT=y
CONFIG_SDIO_PM_CB_SUPPORT=n
CONFIG_PIN_SDIO_GROUP_1=n
CONFIG_SDIO_SLAVE=n
# end of SDIO

#
# SPI
#
CONFIG_SPI_DMA=y
CONFIG_SPI=y
CONFIG_SPI_STATIS=y
CONFIG_SPI_SUPPORT_TX_FIFO_WR_READY=y
CONFIG_SPI_MST_FLASH=y
# end of SPI
#
# QSPI
#
CONFIG_QSPI=y
CONFIG_QSPI_TEST=y
CONFIG_QSPI_MST_FLASH=y
CONFIG_QSPI_FLASH_GD=y
# end of QSPI

#
# GENERAL_DMA
#
CONFIG_GENERAL_DMA=y
CONFIG_DMA_LOGIC_CHAN_CNT=12
CONFIG_DMA_LOGIC_CHAN_ID_MIN=0
# end of GENERAL_DMA

#
# PSRAM
#
CONFIG_PSRAM=n
CONFIG_PSRAM_AS_SYS_MEMORY=n
CONFIG_TASK_STACK_IN_PSRAM=n
# end of PSRAM

#
# Video
#
CONFIG_MEDIA=y
CONFIG_LCD=y
CONFIG_LCD_QSPI=y

CONFIG_LCD_GC9503V=n
CONFIG_LCD_H050IWV=y
CONFIG_LCD_HX8282=y
CONFIG_LCD_MD0430R=y
CONFIG_LCD_MD0700R=y
CONFIG_LCD_NT35512=n
CONFIG_LCD_NT35510=n
CONFIG_LCD_NT35510_MCU=y
CONFIG_LCD_ST7282=y
CONFIG_LCD_ST7796S=y
CONFIG_LCD_ST7701S_LY=y
CONFIG_LCD_ST7701S=y
CONFIG_LCD_ST7701SN=y
CONFIG_LCD_AML01=y

#
# lcd function macro
#
CONFIG_LCD_ROTATE=y
CONFIG_LCD_HW_PFC=y
CONFIG_LCD_HW_DECODE=y
CONFIG_LCD_SW_DECODE=y
# end of lcd function macro

CONFIG_DMA2D=y
CONFIG_JPEGDEC_HW=y
CONFIG_HW_SCALE=y
# end of Video

#
# CALENDAR
#
# end of CALENDAR

#
# System control
#
# CONFIG_SYS_REDUCE_NORMAL_POWER is not set
CONFIG_PM_V2=y
# CONFIG_XTAL_FREQ_40M is not set
CONFIG_XTAL_FREQ_26M=y
CONFIG_XTAL_FREQ=26000000
CONFIG_DCO_FREQ=120000000
CONFIG_SYSTEM_CLOCK=y
# end of System control

#
# PHY
#
# CONFIG_PTA is not set
# end of PHY

#
# I2S
#
CONFIG_I2S=y
# end of I2S

#
# pwm
#
CONFIG_PWM_V1PX=y
# end of pwm

# CONFIG_SUPPORT_IRDA is not set

#
# efuse
#

#
# vfs
#
CONFIG_VFS=y
CONFIG_VFS_TEST=y

# end of Driver

#
# LwIP 2.0.2
#
CONFIG_LWIP=y
CONFIG_TASK_LWIP_PRIO=4

# end of LwIP 2.0.2

#
# LwIP 2.1.2
#
# end of LwIP 2.1.2

#
# Bk_netif
#
CONFIG_BK_NETIF=y
CONFIG_NETIF_LWIP=y
# end of Bk_netif

#
# Power Save
#
CONFIG_PM_V2=y
# end of Power Save

#
# PWR_CLK
#
CONFIG_PM_DEMO_ENABLE=y
CONFIG_PM_CLI_ENABLE=y
CONFIG_PM_LV_SUBCORES_ON=y
# end of PWR_CLK

#
# RF Test
#
# end of RF Test

#
# WiFi RWNX Interface
#
CONFIG_WIFI_KMSG_TASK_PRIO=3
CONFIG_WIFI_KMSG_TASK_STACK_SIZE=4096
CONFIG_WIFI_CORE_TASK_PRIO=2
CONFIG_WIFI_CORE_TASK_STACK_SIZE=2048
CONFIG_RWNX_QOS_MSDU=y
CONFIG_RWNX_SW_TXQ=n
CONFIG_RWNX_FAST_CONNECT=y
# end of WiFi RWNX Interface

CONFIG_SARADC=y
CONFIG_SARADC_MB=y
# CONFIG_SARADC_CALI=y

#
# Supplicant
#
# CONFIG_WPA_TWT_TEST is not set
# end of Supplicant
# end of Components Configuration
# end of ARMINO Configuration

#
# DEMOS_CONFIG
#
CONFIG_FFT=n
# end of DEMOS_CONFIG

CONFIG_SDMADC=y

CONFIG_HW_ROTATE_PFC=y
#
# CONFIG_FREERTOS_USE_TICKLESS_IDLE
#
CONFIG_FREERTOS_USE_TICKLESS_IDLE=1
#
# CONFIG_SYSTICK_32K
#
CONFIG_SYSTICK_32K=y

CONFIG_TIMER_US=y
CONFIG_TIMER_SUPPORT_ID_BITS=56

CONFIG_UART_LOW_VOLTAGE_SUPPORT=y
#
#GPIO for Power Save: WANIING: modify it should check properties/soc/bk7256/bk7256.defconfig also
#
CONFIG_GPIO_WAKEUP_SUPPORT=n
CONFIG_GPIO_DYNAMIC_WAKEUP_SUPPORT=n
CONFIG_GPIO_DYNAMIC_WAKEUP_SOURCE_MAX_CNT=4
CONFIG_GPIO_WAKEUP_DEBUG=n
CONFIG_GPIO_DEFAULT_SET_SUPPORT=n
CONFIG_WIFI_VNET_CONTROLLER=y

CONFIG_CAN=n
CONFIG_CAN_TEST=n

CONFIG_NTP_SYNC_RTC=n
CONFIG_AON_RTC_KEEP_TIME_SUPPORT=y

#
#ETH config
#
CONFIG_ETH=n
CONFIG_PHY_SMSC=y
CONFIG_ETH_PIN_GROUP1=y
CONFIG_ETH_DHCP=n

#
# Bk_Modem
#
CONFIG_BK_MODEM=n
CONFIG_LWIP_PPP_SUPPORT=n
CONFIG_USB_CDC_MODEM=n
CONFIG_USB_CDC=n
```
