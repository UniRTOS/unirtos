## qos_kernel/bk7258/arch_prj/ql_components/unirtos/Kconfig
```kconfig
menu "UNIRTOS_SUPPORT"
	config UNIRTOS_SUPPORT
        bool "Enable UniRTOS Support"
		default y
    # if UNIRTOS_SUPPORT
    #     orsource "../../../../quecos/system/Kconfig"
    # endif
endmenu
```
